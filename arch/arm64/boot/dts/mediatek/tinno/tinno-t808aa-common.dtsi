#include "tinno-t808aa-display.dtsi"
#include "tinno-t808aa-touch.dtsi"
#include "tinno-t808aa-charger.dtsi"
#include "tinno-t808aa-sensor.dtsi"
#include "tinno-t808aa-audio.dtsi"
#include "tinno-t808aa-camera.dtsi"
#include "tinno-t808aa-led.dtsi"
#include "tinno-t808aa-ntc.dtsi"
#include "tinno-t808aa-sd.dtsi"
#include "tinno-t808aa-thermal.dtsi"
#include "tinno-t808aa-microtrust.dtsi"
#include "tinno-t808aa-region.dtsi"
