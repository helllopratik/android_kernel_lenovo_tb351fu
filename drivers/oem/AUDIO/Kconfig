## drivers/oem/Kconfig
```kconfig
config FACTORY_BUILD
        tristate "factory special dirver"
        help
          Say Yes to enable factory special driver

config TOUCHSCREEN_NT36xxx_HOSTDL_SPI_OEM
        tristate  "Novatek NT36xxx host download SPI driver"
        default y
        help
          Say Y here if you have a Novatek NT36xxx no flash touchscreen connected
          to your system by SPI bus.

          If unsure, say N.

source "drivers/oem/NVT_Touch_HostDL/Kconfig"
source "drivers/oem/AUDIO/Kconfig"
source "drivers/oem/switch_charger/Kconfig"
source "drivers/oem/pump_charger/Kconfig"
source "drivers/oem/typec/Kconfig"
source "drivers/oem/gauge/Kconfig"
source "drivers/oem/charge_misc/Kconfig"
source "drivers/oem/Panel/Kconfig"
source "drivers/oem/aw/Kconfig"
# TN Begin modify by yangyp 20231123 OCALLA-80
source "drivers/oem/dev_info/Kconfig"
# TN End modify by yangyp 20231123 OCALLA-80
# TS add begin for adding lcd off charger cooling device OCALLA-609 by lgf 20231204
source "drivers/oem/thermal/Kconfig"
# TS add end for adding lcd off charger cooling deivce OCALLA-609 by lgf 20231204
```

## drivers/oem/Panel/Kconfig
```kconfig
#
#  DRM_PANEL configuration
#
config DRM_PANEL_BOE_NT36523N_VDO
	tristate "boe nt36523n video 90hz panel"
	depends on OF
	depends on DRM_MIPI_DSI
	depends on BACKLIGHT_CLASS_DEVICE
	help
	  Say Y here if you want to enable support for nt36523 fhdplus and
	  wqhd cmd panel. The panel has a 1200x2000 resolution
	  and uses 24-bits RGB per pixel. It provides a MIPI DSI
	  interface to host.
	  
config DRM_PANEL_CSOT_NT36523N_VDO
	tristate "csot nt36523n video 90hz panel"
	depends on OF
	depends on DRM_MIPI_DSI
	depends on BACKLIGHT_CLASS_DEVICE
	help
	  Say Y here if you want to enable support for nt36523 fhdplus and
	  wqhd cmd panel. The panel has a 1200x2000 resolution
	  and uses 24-bits RGB per pixel. It provides a MIPI DSI
	  interface to host.
```

## drivers/oem/charge_misc/Kconfig
```kconfig
config CHARGE_MISC
	tristate "charge misc driver"
	help
	  Say Y to enable support for the misc charge driver.
```

## drivers/oem/dev_info/Kconfig
```kconfig
menu "tinno drivers"

config TINNO_DEVINFO
    tristate "tinno_devinfo"
    help
      support tinno_devinfo

endmenu
```

## drivers/oem/gauge/Kconfig
```kconfig
config GAUGE_MM8XXX
	tristate "Gauge dirver for mitsumi MM8XXX gauge IC"
	help
	Say Yes to enable Mistsumi MM8XXX driver.
```

## drivers/oem/pump_charger/Kconfig
```kconfig
config CHARGER_HL7139
        tristate "Charger Driver for Halomicro HL7139 Charger IC"
        help
          Say Yes to enable Halomicro HL7139 driver.
          It is mainly used as cap divider charger
          for Mediatek platform

config CHARGER_SC854X
        tristate "SC8545-SC8549 Charger Pump driver"
        help
          If you say yes here you will get support for the SC8545-SC8549 Charge Pump.
          This driver can give support for SC8545-SC8549 Interface.
```

## drivers/oem/switch_charger/Kconfig
```kconfig
config CHARGER_SC8989X
        tristate "SC8989X charger driver"
        help
          Say Y to enable support for the SC8989X charger.
          The driver supports controlling switching charger and OTG
          with high-accuracy current and voltage regulation.
          The device is compliant with the USB Battery Charging Specification
          Revision 1.2.

config CHARGER_HL7015DB
        tristate "HL7015DB charger driver"
        help
          Say Y to enable support for the HL7015DB charger.
          The driver supports controlling switching charger and OTG
          with high-accuracy current and voltage regulation.
          The device is compliant with the USB Battery Charging Specification
          Revision 1.2.
```

## drivers/oem/thermal/Kconfig
```kconfig
config CHARGER_COOLER_LCDOFF
        tristate "charger cooler driver when lcd off "
        help
          Say Y to enable support for the lcd off charger cooler . 
          when enable  this charger cooler, the MTK orginal charger cooler will only active when lcd on.
          And this lcd off charger cooler will active when lcd off instead. 

     
```

## drivers/oem/typec/Kconfig
```kconfig
#
# awinic driver configuration
#

config OEM_TCPC_PD_AW35615
	tristate "Awinic Pd"
	depends on I2C
	help
		this option enables support for the AW35615 PD connected
		through I2C. Say Y to enable support for the AW35615 PD


config OEM_TCPC_PD_CPS8851
	tristate "ConvenientPower Pd"
	depends on I2C
	help
		this option enables support for the ConvenientPower PD connected
		through I2C. Say Y to enable support for the CPS8851 PD
```
